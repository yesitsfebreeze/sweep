## config/boards/shields/reset/Kconfig.defconfig
```kconfig
if SHIELD_RESET_LEFT

config ZMK_KEYBOARD_NAME
    default "Sweep"

config ZMK_SPLIT_ROLE_CENTRAL
    default y

endif

if SHIELD_RESET_LEFT || SHIELD_RESET_RIGHT

config ZMK_SPLIT
    default y

endif
```

## config/boards/shields/reset/Kconfig.shield
```kconfig
config SHIELD_RESET_LEFT
    def_bool $(shields_list_contains,reset_left)

config SHIELD_RESET_RIGHT
    def_bool $(shields_list_contains,reset_right)
```
